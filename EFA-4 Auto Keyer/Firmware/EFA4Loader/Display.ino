#define ROTATE 0
#define OLED_address   0x3C  //0x3C or 0x3D

// 'Iconic_COSMAC_Elf_spaceship_scene', 64x32px
const unsigned char logo [] PROGMEM = {
	0x3b, 0x9e, 0x7e, 0x8f, 0x4a, 0xc0, 0x50, 0x40, 0x01, 0x40, 0x77, 0xab, 0x62, 0xe2, 0x06, 0x0b, 
	0x5b, 0x04, 0xdf, 0xad, 0x24, 0x60, 0x23, 0x00, 0x1b, 0x1a, 0xff, 0xeb, 0x0a, 0x40, 0xd1, 0xc1, 
	0x01, 0x00, 0x51, 0x47, 0x20, 0x21, 0x60, 0x62, 0x3f, 0xa7, 0xfb, 0x41, 0xc1, 0x40, 0x60, 0xc2, 
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	0x00, 0x1f, 0x15, 0x15, 0x11, 0x00, 0x1f, 0x10, 0x10, 0x10, 0x00, 0x1f, 0x05, 0x05, 0x01, 0x00
};



// Small 8x8 font
const unsigned char myFont[][8] PROGMEM = {
  {0x00, 0x00, 0x00, 0x00, 0x00, 0x00, 0x00, 0x00}, {0x00, 0x00, 0x5F, 0x00, 0x00, 0x00, 0x00, 0x00}, {0x00, 0x00, 0x07, 0x00, 0x07, 0x00, 0x00, 0x00},
  {0x00, 0x14, 0x7F, 0x14, 0x7F, 0x14, 0x00, 0x00}, {0x00, 0x24, 0x2A, 0x7F, 0x2A, 0x12, 0x00, 0x00}, {0x00, 0x23, 0x13, 0x08, 0x64, 0x62, 0x00, 0x00},
  {0x00, 0x36, 0x49, 0x55, 0x22, 0x50, 0x00, 0x00}, {0x00, 0x00, 0x05, 0x03, 0x00, 0x00, 0x00, 0x00}, {0x00, 0x1C, 0x22, 0x41, 0x00, 0x00, 0x00, 0x00},
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  {0x00, 0x41, 0x36, 0x08, 0x00, 0x00, 0x00, 0x00}, {0x00, 0x02, 0x01, 0x01, 0x02, 0x01, 0x00, 0x00}, {0x00, 0x02, 0x05, 0x05, 0x02, 0x00, 0x00, 0x00}
};
    //==========================================================//
    // Used to send commands to the display.
    static void sendcommand(unsigned char com)
    {
    Wire.beginTransmission(OLED_address); //begin transmitting
    Wire.write(0x80); //command mode
    Wire.write(com);
    Wire.endTransmission(); // stop transmitting
    }
    //==========================================================//
    // Actually this sends a byte, not a char to draw in the display.
    // Display's chars uses 8 byte font the small ones and 96 bytes
    // for the big number font.
    static void SendByte(unsigned char data)
    {
    Wire.beginTransmission(OLED_address); // begin transmitting
    Wire.write(0x40);//data mode
    Wire.write(data);
    Wire.endTransmission(); // stop transmitting
    }
    //==========================================================//
    // Prints a display char (not just a byte)
    // being multiples of 8. This means we have 16 COLS (0-15)
    // and 8 ROWS (0-7).
    static void sendChar(unsigned char data)
    {
    Wire.beginTransmission(OLED_address); // begin transmitting
    Wire.write(0x40);//data mode
    for(int i=0;i<8;i++)
    Wire.write(pgm_read_byte(myFont[data-0x20]+i));
    Wire.endTransmission(); // stop transmitting
    } 
    //==========================================================//
    // Set the cursor position in a 16 COL * 2 ROW map.
    static void setXY(unsigned char col,unsigned char row)
    {
    sendcommand(0xb0+row); //set page address
    sendcommand(0x00+(8*col&0x0f)); //set low col address
    sendcommand(0x10+((8*col>>4)&0x0f)); //set high col address
    }
    //==========================================================//
    // Prints a string regardless the cursor position.
    static void sendStr(unsigned char *string)
    {
    unsigned char i=0;
    while(*string)
    {
    for(i=0;i<8;i++)
    {
    SendByte(pgm_read_byte(myFont[*string-0x20]+i));
    }
    *string++;
    }
    }
    //==========================================================//
    // Prints a string in coordinates X Y, being multiples of 8.
    // This means we have 16 COLS (0-15) and 8 ROWS (0-7).
    static void sendStrXY( char *string, int X, int Y)
    {
    setXY(X,Y);
    unsigned char i=0;
    while(*string)
    {
    for(i=0;i<8;i++)
    {
    SendByte(pgm_read_byte(myFont[*string-0x20]+i));
    }
    *string++;
    }
    }
    //==========================================================//

// Resets display depending on the actual mode.
static void reset_display(void)
{
  displayOff();
  clear_display();
  displayOn();
}
//==========================================================//
// Turns display on.
void displayOn(void)
{
    sendcommand(0xaf);        //display on
}

//==========================================================//
// Turns display off.
void displayOff(void)
{
  sendcommand(0xae);    //display off
}

//==========================================================//
// Clears the display by sendind 0 to all the screen map.
static void clear_display(void)
{
  unsigned char i,k;
  for(k=0;k<4;k++)  //4
  { 
    setXY(0,k);    
    {
      for(i=0;i<128;i++)     //was 128
      {
        SendByte(0);         //clear all COL
        //delay(10);
      }
    }
  }
}
    
//==========================================================//
// Inits oled and draws logo at startup
static void init_OLED(void)
{
  /*
  sequence := { direct_value | escape_sequence }
  direct_value := 0..254
  escape_sequence := value_255 | sequence_end | delay | adr | cs | not_used 
  value_255 := 255 255
  sequence_end = 255 254
  delay := 255 0..127
  adr := 255 0x0e0 .. 0x0ef 
  cs := 255 0x0d0 .. 0x0df 
  not_used := 255 101..254
*/  
  //sendcommand(0xae);    //display off
  //sendcommand(0xa6);            //Set Normal Display (default) 
  // Adafruit Init sequence for 128x32 OLED module
        
    sendcommand(0xAE);            //DISPLAYOFF
    sendcommand(0xD5);            //SETDISPLAYCLOCKDIV
    sendcommand(0x80);            // the suggested ratio 0x80
    sendcommand(0xA8);            //SSD1306_SETMULTIPLEX
    sendcommand(0x1f);            //--1/48 duty, NEW!!! Feb 23, 2013: 128x32 OLED: 0x01f,  128x32 OLED 0x03f
    sendcommand(0xD3);            //SETDISPLAYOFFSET
    sendcommand(0x0);             //no offset
    sendcommand(0x40 | 0x0);      //SETSTARTLINE
    sendcommand(0x8D);            //CHARGEPUMP
    sendcommand(0x14);
    sendcommand(0x20);             //MEMORYMODE
    sendcommand(0x02);             //com pin HW config, sequential com pin config (bit 4), disable left/right remap (bit 5), Feb 23, 2013: 128x32 OLED: 0x002,  128x32 OLED 0x012
#ifdef ROTATE
      if (ROTATE==1) {
        sendcommand(0xA0 | 0x1);      //SEGREMAP   //Rotate screen 180 deg 0xA1
        sendcommand(0xC8); 
        }
      else {
        sendcommand(0xA0);
        sendcommand(0xC0);
      }
    #endif

    sendcommand(0xDA);          //0xDA
    sendcommand(0x02);         //COMSCANDEC /* com pin HW config, sequential com pin config (bit 4), disable left/right remap (bit 5) */
    sendcommand(0x81);         //SETCONTRAS
    sendcommand(0xcf);        //
    sendcommand(0xD9);        //SETPRECHARGE /* [2] pre-charge period 0x022/f1*/
    sendcommand(0xf1); 
    sendcommand(0xDB);        //SETVCOMDETECT                
    sendcommand(0x40);
    sendcommand(0x2E);        // stop scroll
    sendcommand(0xA4);        //DISPLAYALLON_RESUME        
    sendcommand(0xA6);        //NORMALDISPLAY             
    sendcommand(0xAF);         //display on

  #ifdef ScrollLogo
  int start;
  int end;
  if (ScrollLogo==0) {start=4,end=4;}  //Center logo
  else {start=ScrollLogo,end=0;}
  for (int x=start;x>=end;x--)
   {
    clear_display();
    for(int y=0;y<4;y++)
    {
      setXY(x,y);
      for(int i=0;i<64;i++)
      {
        SendByte(pgm_read_byte(logo+y*64+i));
        }
    }
  }
  #endif
}
